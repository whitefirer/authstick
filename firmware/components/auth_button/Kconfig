## firmware/components/auth_button/Kconfig
```kconfig
menu "AuthStick Button"

config BTN_A_PIN
    int "Button A (front) GPIO"
    default 0

config BTN_B_PIN
    int "Button B (side) GPIO"
    default 41

config BTN_LONG_PRESS_MS
    int "Long press threshold (ms)"
    default 1000

endmenu
```

## firmware/components/auth_client/Kconfig
```kconfig
menu "AuthStick Client"

config AUTH_SERVER_URL
    string "Auth server URL"
    default "http://192.168.1.100:8998"
    help
        Base URL of the xiaozhi-auth-mcp server.
        Format: http://<host>:<port>

config AUTH_POLL_INTERVAL_MS
    int "Poll interval (ms)"
    default 3000
    range 1000 30000
    help
        How often to poll the server for pending auth codes.

endmenu
```

## firmware/components/display/Kconfig
```kconfig
menu "AuthStick Display"

config DISPLAY_SPI_HOST
    int "SPI host (1=SPI2/FSPI, 2=SPI3)"
    default 1
    range 1 2

config DISPLAY_PIN_SCLK
    int "SCLK pin"
    default 12

config DISPLAY_PIN_MOSI
    int "MOSI pin"
    default 11

config DISPLAY_PIN_DC
    int "DC pin"
    default 10

config DISPLAY_PIN_RST
    int "RST pin"
    default 9

config DISPLAY_PIN_CS
    int "CS pin"
    default 8

config DISPLAY_PIN_BL
    int "Backlight pin"
    default 4

config DISPLAY_WIDTH
    int "Display width"
    default 135

config DISPLAY_HEIGHT
    int "Display height"
    default 240

endmenu
```

## firmware/main/Kconfig
```kconfig
menu "AuthStick WiFi"

# WiFi config is now done via provisioning web page; these are fallback defaults.

endmenu
```

## firmware/sdkconfig.defaults
```kconfig
# Stick Auth defaults
CONFIG_AUTH_SERVER_URL="http://192.168.0.102:8998"
CONFIG_AUTH_POLL_INTERVAL_MS=3000

# Provisioning
CONFIG_PROV_AP_SSID="AuthStick-Setup"
CONFIG_PROV_DEFAULT_SERVER_URL="http://192.168.1.100:8998"

# Display pins (StickS3: MOSI=39, SCK=40, DC=45, CS=41, RST=21, BL=38)
CONFIG_DISPLAY_SPI_HOST=1
CONFIG_DISPLAY_PIN_SCLK=40
CONFIG_DISPLAY_PIN_MOSI=39
CONFIG_DISPLAY_PIN_DC=45
CONFIG_DISPLAY_PIN_RST=21
CONFIG_DISPLAY_PIN_CS=41
CONFIG_DISPLAY_PIN_BL=38

# Button pins (StickS3: KEY1=11, KEY2=12)
CONFIG_BTN_A_PIN=11
CONFIG_BTN_B_PIN=12

# FreeRTOS
CONFIG_FREERTOS_HZ=1000

# SPI flash
CONFIG_ESPTOOLPY_FLASHSIZE_8MB=y
CONFIG_ESPTOOLPY_FLASHSIZE="8MB"

# PSRAM (ESP32-S3 StickS3 has 8MB Octal PSRAM)
CONFIG_ESP32S3_SPIRAM_SUPPORT=y
CONFIG_SPIRAM=y
CONFIG_SPIRAM_MODE_OCT=y
CONFIG_SPIRAM_SPEED_80M=y
CONFIG_SPIRAM_USE_MALLOC=y
CONFIG_SPIRAM_USE_CAPS_ALLOC=y

# LVGL
CONFIG_LV_USE_FONT_PLACEHOLDER=n
CONFIG_LV_USE_SNAPSHOT=y
CONFIG_LV_USE_IMGFONT=y
CONFIG_LV_FONT_FMT_TXT_LARGE=y

# HTTP server — avoid 431 "Header fields are too long" on captive portal
CONFIG_HTTPD_MAX_REQ_HDR_LEN=1024

# Partition + OS
CONFIG_PARTITION_TABLE_SINGLE_APP_LARGE=y
CONFIG_LV_OS_FREERTOS=y
```
